## boards/armfly_stm32_v6/Kconfig.armfly_stm32_v6
```kconfig
# Copyright (c) 2016 Linaro Limited.
# SPDX-License-Identifier: Apache-2.0

config BOARD_ARMFLY_STM32_V6
select SOC_STM32F429XX
```

## boards/armfly_stm32_v6/Kconfig.defconfig
```kconfig
# SPDX-License-Identifier: Apache-2.0

if BOARD_ARMFLY_STM32_V6

config INPUT
default y if DISPLAY

config MEMC
default y if DISPLAY

endif # BOARD_ARMFLY_STM32_V6
```

## boards/armfly_stm32_v6/board.yml
```yaml
board:
  name: armfly_stm32_v6
  full_name: ARMFLY STM32-V6 (STM32F429BIT6)
  vendor: armfly
  socs:
    - name: stm32f429xx
```
